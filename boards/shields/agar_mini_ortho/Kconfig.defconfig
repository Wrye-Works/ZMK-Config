## boards/shields/agar_mini_ortho/Kconfig.defconfig
```kconfig
if SHIELD_AGAR_MINI_ORTHO

config ZMK_KEYBOARD_NAME
    default "Agar Mini Ortho"

endif # SHIELD_AGAR_MINI_ORTHO

CONFIG_ZMK_STUDIO_LOCKING=n
```

## boards/shields/agar_mini_ortho/Kconfig.shield
```kconfig
config SHIELD_AGAR_MINI_ORTHO
    def_bool $(shields_list_contains,agar_mini_ortho)
```
